## channel/sdkconfig.defaults
```kconfig
# Bluetooth: Classic BT only (no BLE), Bluedroid stack, A2DP sink
CONFIG_BT_ENABLED=y
CONFIG_BTDM_CTRL_MODE_BR_EDR_ONLY=y
CONFIG_BT_BLUEDROID_ENABLED=y
CONFIG_BT_CLASSIC_ENABLED=y
CONFIG_BT_A2DP_ENABLE=y
```
